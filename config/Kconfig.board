## config/Kconfig.board
```kconfig
# isometria75 rev2 board configuration

# Copyright (c) 2020 The ZMK Contributors
# SPDX-License-Identifier: MIT

config BOARD_ble_90
	bool "ble_90 Keyboard"
	depends on SOC_NRF52840_QIAA
```

## config/boards/arm/ble_90/ble_90_defconfig
```kconfig
# SPDX-License-Identifier: MIT

CONFIG_ZMK_KEYBOARD_NAME="jmry"

CONFIG_SOC_SERIES_NRF52X=y
CONFIG_SOC_NRF52840_QIAA=y
CONFIG_BOARD_ble_90=y

# Enable MPU
CONFIG_ARM_MPU=y

# enable GPIO
CONFIG_GPIO=y

CONFIG_USE_DT_CODE_PARTITION=y

CONFIG_MPU_ALLOW_FLASH_WRITE=y
CONFIG_NVS=y
CONFIG_SETTINGS_NVS=y
CONFIG_FLASH=y
CONFIG_FLASH_PAGE_LAYOUT=y
CONFIG_FLASH_MAP=y
CONFIG_CLOCK_CONTROL_NRF=y
CONFIG_CLOCK_CONTROL_NRF_K32SRC_RC=y

#最大同时蓝牙连接数
CONFIG_BT_MAX_CONN=1

#Enabling RGB Underglow
CONFIG_ZMK_RGB_UNDERGLOW=y
CONFIG_WS2812_STRIP=y

# 睡眠自动关闭rgb灯
CONFIG_ZMK_RGB_UNDERGLOW_AUTO_OFF_IDLE=y
# 拔掉USB关灯
# CONFIG_ZMK_RGB_UNDERGLOW_AUTO_OFF_USB=y
#浅度睡眠超时
CONFIG_ZMK_IDLE_TIMEOUT=240000
#启用深度睡眠
#CONFIG_ZMK_SLEEP=y
#深度睡眠超时
#CONFIG_ZMK_IDLE_SLEEP_TIMEOUT=600000

# max/min rgb light
CONFIG_ZMK_RGB_UNDERGLOW_BRT_MIN=0
CONFIG_ZMK_RGB_UNDERGLOW_BRT_MAX=100

# 去抖
CONFIG_ZMK_KSCAN_DEBOUNCE_PRESS_MS=15
CONFIG_ZMK_KSCAN_DEBOUNCE_RELEASE_MS=5

# CONFIG_ZMK_USB_LOGGING=y

# CONFIG_BT_DEVICE_APPEARANCE=961

#实验性：需要从主机键入密钥以配对 BLE 连接
CONFIG_ZMK_BLE_PASSKEY_ENTRY=y
```
